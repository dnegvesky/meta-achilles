## conf/machine/achilles.conf
```bitbake
#@TYPE: Machine
#@NAME: achilles
#@DESCRIPTION: Machine configuration for the REFLEX CES Arria 10 Achilles SoC SOM" 

require conf/machine/include/socfpga.inc

#PREFERRED_VERSION_u-boot-socfpga ?= "v2014.10%"
PREFERRED_VERSION_u-boot-socfpga ?= "v2019.04%"

SPL_BINARY = "u-boot-with-spl.sfp"
UBOOT_BINARY = "u-boot-dtb.img"

#UBOOT_CONFIG ??= "arria10-socdk"
UBOOT_CONFIG ??= "achilles"

#UBOOT_CONFIG[arria10-socdk] = "socfpga_arria10_defconfig"
UBOOT_CONFIG[achilles] = "socfpga_arria10_achilles_defconfig"

#KMACHINE = "arria10"
KMACHINE = "achilles"

PREFERRED_PROVIDER_virtual/kernel = "linux-altera-ltsi"
PREFERRED_VERSION_linux-altera-ltsi = "4.14.130%"

# Default kernel devicetrees
#KERNEL_DEVICETREE ?= "\
#			socfpga_arria10_socdk_sdmmc.dtb \
#			socfpga_arria10_socdk_qspi.dtb \
#			socfpga_arria10_socdk_nand.dtb \
#			"
KERNEL_DEVICETREE ?= "socfpga_arria10_achilles.dtb"

EXTRA_IMAGECMD_jffs2 = "--squash -s 256 -e 64KiB"

SERIAL_CONSOLES ?= "115200;ttyS0"

UBOOT_EXTLINUX ?= "1"
UBOOT_EXTLINUX_LABELS ?= "default"
#UBOOT_EXTLINUX_DEFAULT_LABEL ?= "Arria10 SOCDK SDMMC"
UBOOT_EXTLINUX_DEFAULT_LABEL ?= "Achilles eMMC"

#UBOOT_EXTLINUX_MENU_DESCRIPTION_default ?= "Arria10 SOCDK SDMMC"
UBOOT_EXTLINUX_MENU_DESCRIPTION_default ?= "Achilles eMMC"
UBOOT_EXTLINUX_KERNEL_IMAGE_default ?= "../${KERNEL_IMAGETYPE}"
#UBOOT_EXTLINUX_FDT_default ?= "../socfpga_arria10_socdk_sdmmc.dtb"
UBOOT_EXTLINUX_FDT_default ?= "../socfpga_arria10_achilles.dtb"
UBOOT_EXTLINUX_KERNEL_ARGS_default ?= "rootwait rw earlycon"
UBOOT_EXTLINUX_ROOT_default ?= "root=/dev/mmcblk0p3"

IMAGE_BOOT_FILES ?= " \
        ${KERNEL_DEVICETREE} \
        ${KERNEL_IMAGETYPE} \
        ${UBOOT_BINARY} \
        extlinux.conf;extlinux/extlinux.conf \
        "

#WKS_FILE ?= "sdimage-arria10.wks"
WKS_FILE ?= "emmcimage-achilles.wks"
IMAGE_FSTYPES +="wic"
```

## wic/emmcimage-achilles.wks
```
# short-description: Create an eMMC image for the REFLEX CES Achilles Arria 10 SoC SOM.
# long-description: Create an eMMC image for the REFLEX CES Achilles Arria 10 SoC SOM.
# partition 1: u-boot (A2)
# partition 2: boot files (VFAT)
# partition 3: rootfs (EXT4)

part --source rawcopy --sourceparams="file=u-boot-with-spl.sfp" --ondisk mmcblk --system-id=a2 --align 4 --fixed-size 10M
part --source bootimg-partition --ondisk mmcblk --fstype=vfat --label boot --active --align 4 --size 50M
part / --source rootfs --ondisk mmcblk --fstype=ext4 --label root --align 4 
```
